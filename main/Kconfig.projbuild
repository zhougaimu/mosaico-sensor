## main/Kconfig.projbuild
```kconfig
menu "Mosaico Sensor"

    config WIFI_SSID
        string "WiFi SSID"
        default "my-ssid"

    config WIFI_PASSWORD
        string "WiFi Password"
        default "my-password"

    config REPORT_URL
        string "Report server URL"
        default "http://192.168.1.100:8000/api/sensor"

    config REPORT_INTERVAL_S
        int "Report interval (seconds)"
        default 10
        range 1 3600

    config SENSOR_ADC_CHANNEL
        int "Sensor ADC channel (ADC1)"
        default 0
        range 0 9

endmenu
```

## sdkconfig.defaults
```kconfig
CONFIG_IDF_TARGET="esp32s31"
CONFIG_ESP_MAIN_TASK_STACK_SIZE=8192
CONFIG_ESP_BROWNOUT_DET=n
CONFIG_ESPTOOLPY_FLASHSIZE_16MB=y
CONFIG_PARTITION_TABLE_SINGLE_APP_LARGE=y
CONFIG_TINYUSB_CDC_ENABLED=y
CONFIG_ESPTOOLPY_AFTER_NORESET=y
```
